## arch/arm64/configs/alioth_defconfig
```kconfig
CONFIG_LOCALVERSION="-JoKernel-v1.0-by-Jo_0012"
CONFIG_HZ=300
CONFIG_PREEMPT=y
CONFIG_CGROUPS=y
CONFIG_CGROUP_SCHED=y
CONFIG_FAIR_GROUP_SCHED=y
CONFIG_UCLAMP_TASK=y
CONFIG_SCHED_AUTOGROUP=y
CONFIG_CPU_FREQ=y
CONFIG_CPU_FREQ_GOV_SCHEDUTIL=y
CONFIG_ARM64=y
CONFIG_ARM64_4K_PAGES=y
CONFIG_KERNELSU=y
CONFIG_SND=n
CONFIG_SND_SOC=n
CONFIG_SND_SOC_CS35L41=n
CONFIG_SOUND=n
CONFIG_MEDIA_SUPPORT=n
CONFIG_VIDEO_DEV=n
CONFIG_TECHPACK_AUDIO=n
CONFIG_TECHPACK_CAMERA=n
CONFIG_MODULES=y
CONFIG_MODULE_UNLOAD=y
CONFIG_EXT4_FS=y
CONFIG_VFAT_FS=y
CONFIG_TMPFS=y
CONFIG_PSTORE=y
CONFIG_PSTORE_RAM=y
CONFIG_FS_ENCRYPTION=y
CONFIG_KPROBES=y
CONFIG_HAVE_KPROBES=y
# CONFIG_COMPAT_VDSO is not set
# CONFIG_ARM64_VDSO32 is not set
```

## out/defconfig
```kconfig
CONFIG_PREEMPT=y
CONFIG_UCLAMP_TASK=y
CONFIG_SCHED_AUTOGROUP=y
CONFIG_ARCH_QCOM=y
CONFIG_CPU_FREQ=y
CONFIG_CPU_FREQ_GOV_SCHEDUTIL=y
CONFIG_KPROBES=y
CONFIG_MODULES=y
CONFIG_MODULE_UNLOAD=y
CONFIG_EXT4_FS=y
CONFIG_FS_ENCRYPTION=y
CONFIG_VFAT_FS=y
CONFIG_TMPFS=y
CONFIG_PSTORE=y
CONFIG_PSTORE_RAM=y
```
